## config/boards/shields/hg58/Kconfig.shield
```kconfig
# Copyright (c) 2020 Ryan Cross
# SPDX-License-Identifier: MIT

config SHIELD_HG58_LEFT
	def_bool $(shields_list_contains,hg58_left)

config SHIELD_HG58_RIGHT
	def_bool $(shields_list_contains,hg58_right)
```
